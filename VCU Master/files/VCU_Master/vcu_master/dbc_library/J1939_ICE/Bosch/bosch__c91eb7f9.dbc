VERSION ""

NS_ :

BS_:

BU_:
VAL_TABLE_ GEAR_LEV_POS 4 "D" 3 "N" 2 "R" 1 "S" ;

BO_ 581 CHARGING_STATUS: 8 Vector__XXX
 SG_ CHARGING_STATUS : 24|1@0+ (1,0) [0|0] "" Vector__XXX

BO_ 948 ODOMETER: 8 Vector__XXX
 SG_ TOTAL_DIST_1 : 5|30@0+ (0.001,0) [0|0] "KM" Vector__XXX

BO_ 924 AC_COMPRESSOR: 8 Vector__XXX
 SG_ AC_COMP_STA : 52|1@0+ (1,0) [0|0] "" Vector__XXX

BO_ 693 PARK_BRAKE: 8 Vector__XXX
 SG_ PARK_BRAKE : 19|1@0+ (1,0) [0|0] "" Vector__XXX

BO_ 918 BRAKE_PED: 8 Vector__XXX
 SG_ GEAR_LEV_POS : 45|3@0+ (1,0) [0|0] "" Vector__XXX
 SG_ BRK_PED_TRAVEL : 49|6@0+ (1.66666666666667,0) [0|0] "%" Vector__XXX

BO_ 407 VEH_SPD: 8 Vector__XXX
 SG_ VEH_SPD : 7|12@0+ (0.1125,0) [0|0] "KMPH" Vector__XXX

BO_ 580 DIST_TO_EMPTY: 8 Vector__XXX
 SG_ SOC : 55|7@0+ (1,0) [0|0] "%" Vector__XXX
 SG_ DIST_TO_EMPTY : 30|9@0+ (1,0) [0|0] "KM" Vector__XXX

BO_ 273 ACC_PED: 8 Vector__XXX
 SG_ ACC_PED_POS_PERC_1 : 15|7@0+ (1,0) [0|0] "%" Vector__XXX

BA_DEF_  "BusType" STRING ;
BA_DEF_DEF_  "BusType" "CAN";
VAL_ 581 CHARGING_STATUS 1 "ON" 0 "OFF" ;
VAL_ 924 AC_COMP_STA 1 "ENGAGED" 0 "NOT_ENGAGED" ;
VAL_ 693 PARK_BRAKE 0 "RELEASED" 1 "APPLIED" ;
VAL_ 918 GEAR_LEV_POS 5 "S" 4 "D" 3 "N" 2 "R" ;
