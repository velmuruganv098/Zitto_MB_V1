VERSION ""

NS_ :

BS_:

BU_:

BO_ 1280 can_tx_msg: 8 Vector__XXX
 SG_ msg_counter : 0|32@1+ (1,0) [0|4294967295] "" Vector__XXX

BA_DEF_  "BusType" STRING ;
BA_DEF_DEF_  "BusType" "CAN";
